## sources/meta-izo-base-open/conf/layer.conf
```bitbake
# We have a conf and classes directory, add to BBPATH
BBPATH .= ":${LAYERDIR}"

# We have a packages directory, add to BBFILES
BBFILES += "${LAYERDIR}/recipes-*/*/*.bb \
            ${LAYERDIR}/recipes-*/*/*.bbappend"

BBFILE_COLLECTIONS += "izo-base-open"
BBFILE_PATTERN_izo-base-open := "^${LAYERDIR}/"
BBFILE_PRIORITY_izo-base-open = "5"

#depend on the freescale arm meta
LAYERDEPENDS_izo-base-open = "core fsl-arm"


# This is a place for iZotope-specific policy on yocto output 

# We want dwarf unwinding if perf is enabled
PERF_FEATURES_ENABLE_append = " perf-libunwind"
```

## sources/meta-izo-gamut-open/conf/layer.conf
```bitbake
# This sets up global environment for Gamut Builds
require gamut.conf

# We have a conf and classes directory, add to BBPATH
BBPATH .= ":${LAYERDIR}"

# We have a packages directory, add to BBFILES
BBFILES += "${LAYERDIR}/recipes-*/*/*.bb \
            ${LAYERDIR}/recipes-*/*/*.bbappend"

BBFILE_COLLECTIONS += "izo-gamut-open"
BBFILE_PATTERN_izo-gamut-open := "^${LAYERDIR}/"
BBFILE_PRIORITY_izo-gamut-open = "10"

#depend on the freescale arm meta
LAYERDEPENDS_izo-gamut-open = "izo-base-open"
```

## sources/meta-izo-gamut-open/conf/machine/gamut-r0a.conf
```bitbake
# Copyright (C) 2017, iZotope, Inc. All Rights Reserved
# Released under the BSD-3 license (see COPYING.BSD-3)

#@TYPE: Machine
#@NAME: Gamut r0a
#@SOC: i.MX6SL
#@DESCRIPTION: Machine configuration for i.MX6 MCIMX6SLEVK - gamut
#@MAINTAINER: Matt Campbell <mcampbell@izotope.com>

include conf/machine/include/imx-base.inc
include conf/machine/include/tune-cortexa9.inc

# override to use our local u-boot variant
PREFERRED_PROVIDER_u-boot ??= "u-boot-fslc"
PREFERRED_PROVIDER_virtual/bootloader ??= "u-boot-fslc"

SOC_FAMILY = "mx6:mx6sl"

KERNEL_DEVICETREE = "gamut-r0a.dtb"

UBOOT_CONFIG ??= "sd"
UBOOT_CONFIG[sd] = "mx6slevk_config"
#UBOOT_CONFIG[spinor] = "mx6slevk_spinor_config"
#UBOOT_CONFIG[mfgtool] = "mx6slevk_config"

SERIAL_CONSOLE = "115200 ttymxc0"

MACHINE_FEATURES += " pci wifi bluetooth"

PREFERRED_PROVIDER_virtual/kernel ?= "linux-gamut"
```

## sources/meta-izo-gamut-open/conf/machine/gamut-r1.conf
```bitbake
# Copyright (C) 2017, iZotope, Inc. All Rights Reserved
# Released under the BSD-3 license (see COPYING.BSD-3)

#@TYPE: Machine
#@NAME: Gamut r1
#@SOC: i.MX6SL
#@DESCRIPTION: Machine configuration for iZotope gamut R1 hardware
#@MAINTAINER: Matt Campbell <mcampbell@izotope.com>

include conf/machine/include/imx-base.inc
include conf/machine/include/tune-cortexa9.inc

#include the gamut image types class
IMAGE_CLASSES += "image_types_gamut"

# Set the images to produce
IMAGE_FSTYPES = "update"
# Set compression for rootfs tar
UPDATE_ROOTFS_COMPRESSION = ".gz"

# override to use our local u-boot variant
PREFERRED_PROVIDER_u-boot ??= "u-boot-fslc-gamut"
PREFERRED_PROVIDER_virtual/bootloader ??= "u-boot-fslc-gamut"

SOC_FAMILY = "mx6:mx6sl"

KERNEL_DEVICETREE = "gamut-r1.dtb"

UBOOT_CONFIG ??= "sd"
UBOOT_CONFIG[sd] = "gamut_config"
#UBOOT_CONFIG[spinor] = "mx6slevk_spinor_config"
#UBOOT_CONFIG[mfgtool] = "mx6slevk_config"

SERIAL_CONSOLE = "115200 ttymxc0"

MACHINE_FEATURES += " wifi"

PREFERRED_PROVIDER_virtual/kernel ?= "linux-gamut"

#don't include kernels in standard images
#if you want the image, add kernel-image to the package list for the image
RDEPENDS_kernel-base = ""
```
